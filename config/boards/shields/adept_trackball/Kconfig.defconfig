## config/boards/shields/adept_trackball/Kconfig.defconfig
```kconfig
if SHIELD_ADEPT_TRACKBALL

config ZMK_KEYBOARD_NAME
    default "Adept TB"

# Split peripheral (no ROLE_CENTRAL -> peripheral). The dongle is central.
config ZMK_SPLIT
    default y

# Pointing subsystem is needed on the peripheral (sensor side).
config ZMK_POINTING
    default y

endif

config SPI
    default y if SHIELD_ADEPT_TRACKBALL
```

## config/boards/shields/adept_trackball/Kconfig.shield
```kconfig
config SHIELD_ADEPT_TRACKBALL
    def_bool $(shields_list_contains,adept_trackball)
```

## config/boards/shields/totem/Kconfig.defconfig
```kconfig
# Copyright (c) 2022 The ZMK Contributors
# SPDX-License-Identifier: MIT

# In the dongle setup BOTH halves are peripherals; the dongle is the sole
# central. (Previously totem_left was central.)
if SHIELD_TOTEM_LEFT || SHIELD_TOTEM_RIGHT

config ZMK_KEYBOARD_NAME
    default "TOTEM"

config ZMK_SPLIT
    default y

# The shared totem keymap references &mkp (trackball buttons, bound on the
# central). Split peripherals still compile the keymap, so the pointing
# behaviors must resolve here too, or the totem_left/right devicetree build
# fails on an undefined &mkp phandle. No pointing hardware runs on the halves.
config ZMK_POINTING
    default y

endif

if SHIELD_TOTEM_DONGLE

config ZMK_KEYBOARD_NAME
    default "TOTEM"

config ZMK_SPLIT
    default y

config ZMK_SPLIT_ROLE_CENTRAL
    default y

# Left half + right half + Adept trackball
config ZMK_SPLIT_BLE_CENTRAL_PERIPHERALS
    default 3

# 3 peripherals + host BT profiles
config BT_MAX_CONN
    default 8

config BT_MAX_PAIRED
    default 8

# Pointing (trackball forwarded over the split) and per-peripheral battery
config ZMK_POINTING
    default y

config ZMK_SPLIT_BLE_CENTRAL_BATTERY_LEVEL_FETCHING
    default y

endif
```

## config/west.yml
```yaml
manifest:
  remotes:
    - name: zmkfirmware
      url-base: https://github.com/zmkfirmware
    - name: badjeff
      url-base: https://github.com/badjeff
    - name: diagbyte
      url-base: https://github.com/diagbyte
  projects:
    - name: zmk
      remote: zmkfirmware
      revision: main
      import: app/west.yml
    # PMW3610 optical sensor driver for the Adept trackball (BLE mod)
    - name: zmk-pmw3610-driver
      remote: badjeff
      revision: main
    # Asurada dongle display module (GC9A01 + CST816S + status screen)
    - name: asurada_dongle
      remote: diagbyte
      revision: dongle-display-ui
  self:
    path: config
```
